## FIT/uImage.its
```
/*
 * U-Boot uImage source file with multiple kernels, ramdisks and FDT blobs
 */

/dts-v1/;

/ {
    description = "Various kernels, ramdisks and FDT blobs";
    #address-cells = <1>;

    images {
        kernel@1 {
            description = "Kernel";
            data = /incbin/("./zImage");
            type = "kernel";
            arch = "arm";
            os = "linux";
            compression = "none";
            load = <0x8000>;
            entry = <0x8000>;

        };

        ramdisk@1 {
            description = "ramdisk";
            data = /incbin/("./rootfs.ext2.gz");
            type = "ramdisk";
            arch = "arm";
            os = "linux";
            compression = "gzip";
            load = <0x00800000>;
            entry = <0x00800000>;

        };

        fdt@1 {
            description = "devicetree";
            data = /incbin/("./cpsc2-zynq7.dtb");
            type = "flat_dt";
            arch = "arm";
            compression = "none";

        };

    };

    configurations {
        default = "config@1";

        config@1 {
            description = "cpsc2";
            kernel = "kernel@1";
            ramdisk = "ramdisk@1";
            fdt = "fdt@1";
        };
    };
};
```
